## conf/distro/anaconda.conf
```bitbake
# use systemd as the default init manager
# comment the following lines to use 'sysvinit' as the init manager
VIRTUAL-RUNTIME_init_manager = "systemd"
DISTRO_FEATURES_BACKFILL_CONSIDERED_append = " sysvinit"
DISTRO_FEATURES_append = " systemd"

DISTRO_FEATURES_append = " \
    x11 \
    opengl \
    pam \
"

VIRTUAL-RUNTIME_base-utils = "busybox"

SYSTEMD_AUTO_ENABLE_pn-lvm2 = "enable"

KERNEL_CLASSES_append = " anaconda_kernel"

IMAGE_FEATURES_append = " package-management"

# Want ldconfig in the output package
# The python module require it
DISTRO_FEATURES_append = " ldconfig"

# It works for both of syslinux and grub-efi
LABELS_LIVE = "boot"

# Have graphics and serial in the boot menu when use grub-efi in iso
GRUB_GFXSERIAL = "1"

QB_MEM_qemux86-64 = "-m 2048"

HOSTTOOLS_append = " tac"

MACHINE_FEATURES_append = " efi pcbios"

UVESA_MODE = "1024x768-32"
```

## conf/layer.conf
```bitbake
# We have a conf and classes directory, add to BBPATH
BBPATH =. "${LAYERDIR}:"

# We have a packages directory, add to BBFILES
BBFILES += "${LAYERDIR}/recipes-*/*/*.bb \
            ${LAYERDIR}/recipes-*/*/*.bbappend"

BBFILE_COLLECTIONS += "meta-anaconda"
BBFILE_PATTERN_meta-anaconda = "^${LAYERDIR}/"
BBFILE_PRIORITY_meta-anaconda = "10"

LAYERVERSION_meta-anaconda = "2"

LAYERDEPENDS_meta-anaconda = " \
    core \
    openembedded-layer \
    filesystems-layer \
    gnome-layer \
    meta-python \
    networking-layer \
    meta-initramfs \
"

LICENSE_PATH += "${LAYERDIR}/licenses"
SRC_DISTRIBUTE_LICENSES += "X11"
SRC_DISTRIBUTE_LICENSES += "FLTK"

LAYER_PATH_meta-anaconda = "${LAYERDIR}"

KERNEL_CLASSES_append = " ${@bb.utils.contains('DISTRO_FEATURES', 'anaconda-support', 'anaconda_support_kernel', '', d)}"
IMAGE_CLASSES_append = " ${@bb.utils.contains('DISTRO_FEATURES', 'anaconda-support', 'anaconda_support_image', '', d)}"

DISTRO_FEATURES_append = " \
    pam \
"
```
